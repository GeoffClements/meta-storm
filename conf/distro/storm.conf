## conf/distro/storm.conf
```bitbake
DISTRO_NAME = "storm"
DISTRO_VERSION = "0.1"

DISTRO_FEATURES = "alsa ipv6 systemd"
DISTRO_FEATURES_BACKFILL_CONSIDERED = "opengl pulseaudio sysvinit x11"

VIRTUAL-RUNTIME_init_manager = "systemd"

hostname_pn-base-files = "storm"

PACKAGECONFIG_remove_pn-gstreamer1.0-plugins-good = " \
    bz2 \
    cairo \
    gdk-pixbuf \
    gudev \
    jpeg \
    lame \
    libpng \
    speex \
    v4l2 \
    zlib \
"
PACKAGECONFIG_remove_pn-gstreamer1.0-plugins-base = " \
    jpeg \
    pango \
    png \
    theora \
    zlib \
"

PACKAGECONFIG_append_pn_gstreamer1.0-libav = " libav"

PACKAGECONFIG_pn_ffmpeg = "avcodec"

# rpi specific

DISABLE_VC4GRAPHICS = "1"

RPI_EXTRA_CONFIG = ' \n \
   dtoverlay=hifiberry-amp \n \
   dtoverlay=hifiberry-dac \n \
   dtoverlay=hifiberry-dacplus \n \
   dtoverlay=hifiberry-digi \n \
   dtoverlay=iqaudio-dac \n \
   dtoverlay=iqaudio-dacplus \n \
'
```

## conf/layer.conf
```bitbake
# We have a conf and classes directory, add to BBPATH
BBPATH .= ":${LAYERDIR}"

# We have recipes-* directories, add to BBFILES
BBFILES += "${LAYERDIR}/recipes-*/*/*.bb \
            ${LAYERDIR}/recipes-*/*/*.bbappend"

BBFILE_COLLECTIONS += "meta-storm"
BBFILE_PATTERN_meta-storm = "^${LAYERDIR}/"
BBFILE_PRIORITY_meta-storm = "6"

LAYERDEPENDS_meta-storm = "core rust-layer"
LAYERSERIES_COMPAT_meta-storm = "warrior zeus"
```
